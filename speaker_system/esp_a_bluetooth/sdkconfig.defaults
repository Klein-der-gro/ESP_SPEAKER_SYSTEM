## speaker_system/esp_b_wifi_hub/sdkconfig.defaults
```kconfig
CONFIG_BT_ENABLED=n
CONFIG_ESP_DEFAULT_CPU_FREQ_MHZ_240=y
CONFIG_COMPILER_OPTIMIZATION_PERF=y
CONFIG_ESPTOOLPY_FLASHSIZE_4MB=y
CONFIG_ESP_WIFI_ENABLED=y
CONFIG_ESP_WIFI_STATIC_RX_BUFFER_NUM=16
CONFIG_ESP_WIFI_DYNAMIC_RX_BUFFER_NUM=64
CONFIG_LWIP_MAX_SOCKETS=16
CONFIG_LWIP_UDP_RECVMBOX_SIZE=32
CONFIG_PARTITION_TABLE_SINGLE_APP_LARGE=y
```
